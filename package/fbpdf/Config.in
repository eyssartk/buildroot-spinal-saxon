## package/lcms2_2_13/Config.in
```kconfig
config BR2_PACKAGE_LCMS2_2_13
	bool "lcms2_2_13"
	help
	  Little Color Management Software (CMS) intends to be an OPEN
	  SOURCE small-footprint color management engine, with special
	  focus on accuracy and performance.
	  It uses the International Color Consortium standard (ICC),
	  which is the modern standard when regarding to color
	  management.

	  http://www.littlecms.com/
```

## package/mupdf/Config.in
```kconfig
config BR2_PACKAGE_MUPDF
	bool "MUPDF"
    select BR2_PACKAGE_JBIG2DEC 
    select BR2_PACKAGE_LIBJPEG 
    select BR2_PACKAGE_OPENJPEG 
    select BR2_PACKAGE_LIBZLIB
	help
	  MUPDF package.
```

## package/xpdf/Config.in
```kconfig
config BR2_PACKAGE_XPDF
	bool "XPDF"
    depends on BR2_PACKAGE_QT5
	help
	  XPDF package.
```
